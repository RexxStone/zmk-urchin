## config/west.yml
```yaml
manifest:
  remotes:
      # zmk official
    - name: zmkfirmware
      url-base: https://github.com/zmkfirmware
      # bravekarma
    - name: caksoylar
      url-base: https://github.com/caksoylar
    # theol, additional sticky key functionality
    - name: theol0403
      url-base: https://github.com/theol0403
  projects:
    - name: zmk
      remote: theol0403
      revision: local
      import: app/west.yml
  self:
    path: config
```
